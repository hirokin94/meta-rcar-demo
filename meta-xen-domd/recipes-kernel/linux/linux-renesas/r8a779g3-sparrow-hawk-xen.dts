#include "r8a779g3-sparrow-hawk.dts"
#include "r8a779g3-xen-chosen.dtsi"
#include "r8a779g3-xen.dts"

/ {
	model = "Retronix Sparrow Hawk board based on r8a779g3, running XEN hypervisor";

	/* Workaround U-Boot issue with memory nodes duplication */
	/delete-node/ memory@48000000;
	/delete-node/ memory@480000000;
	/delete-node/ memory@600000000;
	memory@48000000 {
		device_type = "memory";
		/* first 128MB is reserved for secure area. */
		reg = <0x0 0x48000000 0x0 0x78000000
		       0x4 0x80000000 0x0 0x80000000
		       0x6 0x00000000 0x1 0x00000000>;
	};

	/*
	 * OP-TEE firmware node.
	 * Consumed by Xen (with tee=optee bootarg) so that it can mediate
	 * OP-TEE SMC calls from Dom0/DomD. Xen then presents an equivalent
	 * node to Dom0 automatically. The secure DRAM region (first 128MB
	 * of DRAM, 0x40000000-0x48000000) is already excluded from the
	 * memory node above and used by BL31/BL32 (TF-A + OP-TEE OS).
	 */
	firmware {
		optee {
			compatible = "linaro,optee-tz";
			method = "smc";
		};
	};
};

